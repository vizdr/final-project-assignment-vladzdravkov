## meta-can-server/conf/layer.conf
```bitbake
# Layer configuration for meta-can-server

BBPATH .= ":${LAYERDIR}"

BBFILES += "${LAYERDIR}/recipes-*/*/*.bb \
            ${LAYERDIR}/recipes-*/*/*.bbappend"

BBFILE_COLLECTIONS += "can-server"
BBFILE_PATTERN_can-server := "^${LAYERDIR}/"
BBFILE_PRIORITY_can-server = "6"

LAYERSERIES_COMPAT_can-server = "kirkstone"
```

## meta-can/conf/layer.conf
```bitbake
# meta-can layer configuration
# Provides CAN (MCP2515, SocketCAN) enablement and related utilities

BBPATH .= ":${LAYERDIR}"
BBFILES += "${LAYERDIR}/recipes-*/*/*.bb \
            ${LAYERDIR}/recipes-*/*/*.bbappend"

# --- Layer Identification ---
BBFILE_COLLECTIONS += "can"
BBFILE_PATTERN_can := "^${LAYERDIR}/"
BBFILE_PRIORITY_can = "6"

# --- Dependencies ---
# This layer depends on core and raspberrypi (for kernel overlays)
LAYERDEPENDS_can = "core raspberrypi"
LAYERSERIES_COMPAT_can = "kirkstone"
```

## meta-sound-sensor/conf/layer.conf
```bitbake
# meta-sound-sensor/conf/layer.conf
# Layer configuration for Sound Sensor support

BBPATH .= ":${LAYERDIR}"
BBFILES += "${LAYERDIR}/recipes-*/*/*.bb"

BBFILE_COLLECTIONS += "sound-sensor"
BBFILE_PATTERN_sound-sensor := "^${LAYERDIR}/"
BBFILE_PRIORITY_sound-sensor = "6"
LAYERSERIES_COMPAT_sound-sensor = "kirkstone"
```
